/*
 * DB9-to-SPI Arduino Gamepad Adapter Firmware
 * For ATmega328P (8 MHz or 16 MHz, 3.3V) - Arduino Nano / Pro Mini
 *
 * Implements an ultra-low latency SPI Slave communicating with the Tang Nano 20k core.
 * Uses SPI Mode 3 (CPOL=1, CPHA=1), MSB-first.
 * SPI Clock is generated by FPGA Master (~720 kHz).
 *
 * Smart Polling Protocol:
 * - Command 0x02 (VBlank Poll): Reads 2 bytes (Joy1 + Fires, Joy2 directions).
 * - Command 0x01 (Fast HSync Poll): Reads 4 bytes of analog paddles (Paddle 1 to 4).
 *
 * Auto-Prediction Logic:
 * - A timer or inactivity measurement checks the duration since the last CS rising edge.
 * - If CS remains HIGH for > 150 us, it's a VBlank/VInterval pause -> preloads Joystick Byte 0 (Command 0x02).
 * - If CS goes LOW before 150 us, it's a scanline HSync poll -> preloads Paddle 1 (Command 0x01).
 *
 * Pin Mapping:
 * - SPI (Hardware):
 *   - Pin 10 (PB2): CS/SS (Input)
 *   - Pin 11 (PB3): MOSI (Input)
 *   - Pin 12 (PB4): MISO (Output)
 *   - Pin 13 (PB5): SCK (Input)
 * - Joystick 1:
 *   - Pin 2 (PD2): UP
 *   - Pin 3 (PD3): DOWN
 *   - Pin 4 (PD4): LEFT (Paddle 1 Button)
 *   - Pin 5 (PD5): RIGHT (Paddle 2 Button)
 *   - Pin 6 (PD6): FIRE
 * - Joystick 2:
 *   - Pin 7 (PD7): UP
 *   - Pin 8 (PB0): DOWN
 *   - Pin 9 (PB1): LEFT (Paddle 3 Button)
 *   - Pin A4 (PC4): RIGHT (Paddle 4 Button)
 *   - Pin A5 (PC5): FIRE
 * - Paddles (Analog):
 *   - Pin A0 (PC0): Paddle 1
 *   - Pin A1 (PC1): Paddle 2
 *   - Pin A2 (PC2): Paddle 3
 *   - Pin A3 (PC3): Paddle 4
 */

#include <Arduino.h>
#include <avr/io.h>
#include <avr/interrupt.h>

// Volatile state registers updated in background and read during SPI transactions
volatile uint8_t byte0_val = 0xFF;  // Default pull-up values (all released)
volatile uint8_t byte1_val = 0xFF;
volatile uint8_t paddle1_val = 0x00;
volatile uint8_t paddle2_val = 0x00;
volatile uint8_t paddle3_val = 0x00;
volatile uint8_t paddle4_val = 0x00;

// CS Edge tracking variables
volatile uint32_t last_cs_high_time = 0;
volatile bool cs_was_high = true;

// Quick Analog Read using custom ADC calls to avoid Arduino analogRead() overhead
uint8_t readADC(uint8_t channel) {
    // Select channel (PC0-PC3), keep AVcc reference, right-aligned (we read ADCH/ADCL)
    ADMUX = (1 << REFS0) | (channel & 0x07);
    
    // Start conversion
    ADCSRA |= (1 << ADSC);
    
    // Wait for conversion to complete
    while (ADCSRA & (1 << ADSC));
    
    // Convert 10-bit to 8-bit
    return (ADC >> 2);
}

void setup() {
    // 1. Configure Joystick Input pins with internal Pull-up resistors
    // Port D inputs: PD2, PD3, PD4, PD5, PD6, PD7
    DDRD &= ~((1 << DDD2) | (1 << DDD3) | (1 << DDD4) | (1 << DDD5) | (1 << DDD6) | (1 << DDD7));
    PORTD |= (1 << PORTD2) | (1 << PORTD3) | (1 << PORTD4) | (1 << PORTD5) | (1 << PORTD6) | (1 << PORTD7);

    // Port B inputs: PB0, PB1
    DDRB &= ~((1 << DDB0) | (1 << DDB1));
    PORTB |= (1 << PORTB0) | (1 << PORTB1);

    // Port C digital inputs: PC4, PC5
    DDRC &= ~((1 << DDC4) | (1 << DDC5));
    PORTC |= (1 << PORTC4) | (1 << PORTC5);

    // 2. Configure Analog Pins for Paddles (inputs, no pull-ups)
    DDRC &= ~((1 << DDC0) | (1 << DDC1) | (1 << DDC2) | (1 << DDC3));
    PORTC &= ~((1 << PORTC0) | (1 << PORTC1) | (1 << PORTC2) | (1 << PORTC3));

    // Initialize ADC with Prescaler 64 (provides ~250 kHz ADC clock at 16 MHz or ~125 kHz at 8 MHz)
    ADCSRA = (1 << ADEN) | (1 << ADPS2) | (1 << ADPS1) | (0 << ADPS0);

    // 3. Configure SPI Slave Pins
    DDRB |= (1 << DDB4);     // MISO as Output
    DDRB &= ~((1 << DDB2) | (1 << DDB3) | (1 << DDB5)); // SCK, MOSI, SS as Input
    PORTB |= (1 << PORTB2);  // Enable pull-up on CS/SS

    // Enable SPI in Slave Mode, SPI Mode 3 (CPOL=1, CPHA=1), MSB-first
    SPCR = (1 << SPE) | (1 << CPOL) | (1 << CPHA);
    
    // Clear SPI Status and Data registers
    uint8_t dummy = SPSR;
    dummy = SPDR;

    // 4. Configure Pin Change Interrupt on SS/CS pin (PB2 / D10 / PCINT2)
    PCICR |= (1 << PCIE0);     // Enable Pin Change Interrupt group 0 (Port B)
    PCMSK0 |= (1 << PCINT2);   // Enable interrupt specifically for PB2 (SS)

    // Preload SPDR with default Byte 0
    SPDR = byte0_val;
    
    sei(); // Enable global interrupts
}

// PCINT0 ISR handles the rising and falling edges of CS (SS Pin)
ISR(PCINT0_vect) {
    // Check if CS is LOW (Active) or HIGH (Inactive)
    if (!(PINB & (1 << PINB2))) {
        // --- CS Falling Edge (Transaction Starts) ---
        cs_was_high = false;
        
        // Wait for first byte transmission to complete (full duplex)
        while (!(SPSR & (1 << SPIF)));
        uint8_t command = SPDR;  // Read command (0x01 or 0x02) from Master
        
        if (command == 0x02) {
            // VBlank Poll: Transmit Byte 1 (Joy2)
            SPDR = byte1_val;
            
            // Wait for second byte transmission
            while (!(SPSR & (1 << SPIF)));
            dummy_read(SPDR);
            
        } else if (command == 0x01) {
            // Fast Scanline Poll: Transmit Paddle 2, Paddle 3, Paddle 4 sequentially
            SPDR = paddle2_val;
            while (!(SPSR & (1 << SPIF)));
            dummy_read(SPDR);
            
            SPDR = paddle3_val;
            while (!(SPSR & (1 << SPIF)));
            dummy_read(SPDR);
            
            SPDR = paddle4_val;
            while (!(SPSR & (1 << SPIF)));
            dummy_read(SPDR);
        }
        
    } else {
        // --- CS Rising Edge (Transaction Ended) ---
        cs_was_high = true;
        last_cs_high_time = micros();  // Record time of CS transition to HIGH
        
        // Default prediction: load paddle1_val assuming next will be a fast HSync poll (0x01)
        SPDR = paddle1_val;
    }
}

// Helper inline function to avoid compiler unused variable warnings
inline void dummy_read(uint8_t val) {
    (void)val;
}

void loop() {
    // Only read inputs and convert ADC if communication is idle (CS is HIGH)
    if (PINB & (1 << PINB2)) {
        
        // 1. Read digital Joystick states (Active-Low)
        uint8_t pD = PIND;
        uint8_t pB = PINB;
        uint8_t pC = PINC;

        // Byte 0: [7:6] Res, [5] Joy2 Fire, [4] Joy1 Fire, [3] J1 Right, [2] J1 Left, [1] J1 Down, [0] J1 Up
        uint8_t b0 = 0xC0; // 0b11000000 (Reserved high)
        if (pD & (1 << PORTD2)) b0 |= (1 << 0); // J1 Up
        if (pD & (1 << PORTD3)) b0 |= (1 << 1); // J1 Down
        if (pD & (1 << PORTD4)) b0 |= (1 << 2); // J1 Left
        if (pD & (1 << PORTD5)) b0 |= (1 << 3); // J1 Right
        if (pD & (1 << PORTD6)) b0 |= (1 << 4); // J1 Fire
        if (pC & (1 << PORTC5)) b0 |= (1 << 5); // J2 Fire
        byte0_val = b0;

        // Byte 1: [7:4] Res, [3] J2 Right, [2] J2 Left, [1] J2 Down, [0] J2 Up
        uint8_t b1 = 0xF0; // 0b11110000 (Reserved high)
        if (pD & (1 << PORTD7)) b1 |= (1 << 0); // J2 Up
        if (pB & (1 << PORTB0)) b1 |= (1 << 1); // J2 Down
        if (pB & (1 << PORTB1)) b1 |= (1 << 2); // J2 Left
        if (pC & (1 << PORTC4)) b1 |= (1 << 3); // J2 Right
        byte1_val = b1;

        // 2. Read analog Paddle positions
        paddle1_val = readADC(0); // PC0
        paddle2_val = readADC(1); // PC1
        paddle3_val = readADC(2); // PC2
        paddle4_val = readADC(3); // PC3
        
        // 3. Smart Pause Detection:
        // If the CS pin stays HIGH for longer than 150 microseconds, we are in a VBlank
        // or inter-frame interval. Force pre-loading of Joystick Byte 0 (Command 0x02)
        // instead of the default Paddle 1 prediction.
        if (cs_was_high && (micros() - last_cs_high_time > 150)) {
            SPDR = byte0_val;
        }
    }
}
